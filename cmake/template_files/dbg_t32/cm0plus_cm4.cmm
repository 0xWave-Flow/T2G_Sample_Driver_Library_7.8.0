;#################################################################################
; This file is generated by CMake during the configuration phase!
; Any user modification may be overwritten, therefore please consider to modify the 
; generation template file located in the folder <SDL>/cmake/template_files/t32
;#################################################################################

; --------------------------------------------------------------------------------
; Customization variables
&BREAKPOINT_LABEL_M0="main"
&BREAKPOINT_LABEL_M4="main"

; --------------------------------------------------------------------------------
WinCLEAR

; --------------------------------------------------------------------------------
; Check prerequisites
IF SYStem.INSTANCE()!=1.
(
  PRINT %ERROR "This script must be called from MASTER GUI!"
  ENDDO
)

; --------------------------------------------------------------------------------
; Store current script path in &ppd
PRIVATE &ppd
&ppd=OS.PPD()

; --------------------------------------------------------------------------------
; [optional] Close any existing REMOTE GUIs
; IC OTHERS QUIT

; --------------------------------------------------------------------------------
; Open all SLAVE GUIs
TargetSystem.NewInstance M4 /ARCHitecture ARM /ONCE

; --------------------------------------------------------------------------------
; Set titles for GUIs
TITLE "CM0+ (${T32_DEVICE_NAME}) - TRACE32 for ARM"
InterCom M4 TITLE "CM4 (${T32_DEVICE_NAME}) - TRACE32 for ARM"

; --------------------------------------------------------------------------------
; Set Trace32 MDI window position and size
FramePOS 0% 0% 50% 100% Auto
InterCom M4 FramePOS 50% 0% 50% 100% Auto

; --------------------------------------------------------------------------------
; SYStem settings
RESet
SYStem.RESet
SYStem.CPU ${T32_DEVICE_NAME}-CM0+
SYStem.CONFIG CORE 1. 1.
SYStem.CONFIG SLAVE OFF
InterCom M4 RESet
InterCom M4 SYStem.RESet
InterCom M4 SYStem.CPU ${T32_DEVICE_NAME}-CM4
InterCom M4 SYStem.CONFIG CORE 2. 1.
InterCom M4 SYStem.CONFIG SLAVE ON
SYStem.CONFIG DEBUGPORTTYPE SWD
SYStem.CONFIG SWDP  ON
IF COMBIPROBE()||UTRACE()
(
  SYStem.CONFIG.CONNECTOR MIPI20T
)
SYStem.Option DUALPORT ON
InterCom M4 SYStem.Option DUALPORT ON
(
  ; assert reset line and do another debugger based reset
  ; -> M0+ should stop in BootROM/Supervisory Flash
  SYStem.Option EnReset ON
  SYStem.Option WaitIDCODE ON
  SYStem.Option CoreSightRESet ON
)
SYStem.MemAccess DAP
SYStem.JtagClock 10MHz
Trace.DISable
InterCom M4 Trace.DISable
InterCom M4 ETM.OFF
InterCom M4 ITM.OFF
SYStem.Up

; --------------------------------------------------------------------------------
; Flash programming

; prepare flash programming (declarations)
DO ~~/demo/arm/flash/traveo_ii PREPAREONLY

; ReProgram Flash
FLASH.ReProgram ALL
Data.LOAD.Elf "&(ppd)/../${ARG_EXE_NAME_CM0PLUS}${CMAKE_EXECUTABLE_SUFFIX}" /NoRegister
Data.LOAD.Elf "&(ppd)/../${ARG_EXE_NAME_CM4}${CMAKE_EXECUTABLE_SUFFIX}" /NoRegister /NosYmbol
FLASH.ReProgram OFF

; --------------------------------------------------------------------------------
; Reset the target again
SYStem.Up

; --------------------------------------------------------------------------------
; Attach CM4, load symbols and prepare a breakpoint that should be hit once CM0+ enables CM4
InterCom M4 SYStem.Mode.Attach
InterCom M4 Data.LOAD.Elf "&(ppd)/../${ARG_EXE_NAME_CM4}${CMAKE_EXECUTABLE_SUFFIX}" /NoRegister /NoCODE
InterCom M4 TrOnchip.Set CORERESET OFF
InterCom M4 Break.direct &BREAKPOINT_LABEL_M4 /Onchip

; --------------------------------------------------------------------------------
; Initialize ONCHIP trace (M0+ MTB)
Trace.METHOD Onchip
Trace.TBADDRESS 0xf0010000
Trace.SIZE 4096.

; --------------------------------------------------------------------------------
; Start CM0+ program execution

; continue go till configured label (e.g. "main") if stopped at vector catch
REPEAT
(
  Go.direct &BREAKPOINT_LABEL_M0
  WAIT !STATE.RUN()
)
WHILE STATE.TARGET()=="stopped at vector catch"

; --------------------------------------------------------------------------------
; Initialize cross trigger
(
  ; Normally, trigger signals from the ETM are routed via the ATB, together
  ; with the trace bus. However, this does not seem to work on this chip, so
  ; instead we route the trigger signal via the CoreSight cross trigger.

  ; CM4_CM4CTI_CTICONTROL: set GLBEN
  InterCom M4 Data.Set AD:0xE0042000 %Long 1.<<0.
  ; CM4_CM4CTI_CTIINEN7: route ETM trigger output to CTM channel 3
  InterCom M4 Data.Set AD:0xE004203C %Long 1.<<3.

  ; CM4_TRCCTI_CTICONTROL: set GLBEN
  InterCom M4 Data.Set AD:0xE0080000 %Long 1.<<0.
  ; CM4_TRCCTI_CTIOUTEN1: route CTM channel 3 to ETB trigger input
  InterCom M4 Data.Set AD:0xE00800A4 %Long 1.<<3.
)

; --------------------------------------------------------------------------------
; Initialize ONCHIP trace (M4: ETB)
InterCom M4 Trace.METHOD Onchip
InterCom M4 Trace.TraceCONNECT ETB
InterCom M4 ETM.Trace ON
InterCom M4 ETM.ON

; --------------------------------------------------------------------------------
; Open some default windows
WinCLEAR
Mode.Hll
WinPOS 0% 0% 50% 50%
List.auto
InterCom M4 WinCLEAR
InterCom M4 Mode.Hll
InterCom M4 WinPOS 0% 0% 50% 50%
InterCom M4 List.auto
InterCom M4 WinPOS 50% 0% 50% 50%
InterCom M4 Trace.List

ENDDO

