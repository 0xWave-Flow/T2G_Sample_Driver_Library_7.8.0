;#################################################################################
; This file is generated by CMake during the configuration phase!
; Any user modification may be overwritten, therefore please consider to modify the 
; generation template file located in the folder <SDL>/cmake/template_files/t32
;#################################################################################

; --------------------------------------------------------------------------------
; Customization variables
&BREAKPOINT_LABEL_M0="main"
&BREAKPOINT_LABEL_M7_0="main"

; --------------------------------------------------------------------------------
WinCLEAR

; --------------------------------------------------------------------------------
; Check prerequisites
IF SYStem.INSTANCE()!=1.
(
  PRINT %ERROR "This script must be called from MASTER GUI!"
  ENDDO
)

; --------------------------------------------------------------------------------
; Store current script path in &ppd
PRIVATE &ppd
&ppd=OS.PPD()

; --------------------------------------------------------------------------------
; [optional] Close any existing REMOTE GUIs
; IC OTHERS QUIT

; --------------------------------------------------------------------------------
; Open all SLAVE GUIs
TargetSystem.NewInstance M7_0 /ARCHitecture ARM /ONCE

; --------------------------------------------------------------------------------
; Set titles for SLAVE GUIs
TITLE "CM0+ (${T32_DEVICE_NAME}) - TRACE32 for ARM"
InterCom M7_0 TITLE "CM7_0 (${T32_DEVICE_NAME}) - TRACE32 for ARM"

; --------------------------------------------------------------------------------
; Set Trace32 MDI window position and size
FramePOS 0% 0% 50% 100% Auto
InterCom M7_0 FramePOS 50% 0% 50% 100% Auto

; --------------------------------------------------------------------------------
; SYStem settings
RESet
SYStem.RESet
SYStem.CPU ${T32_DEVICE_NAME}-CM0+
SYStem.CONFIG CORE 1. 1.
SYStem.CONFIG SLAVE OFF
InterCom M7_0 RESet
InterCom M7_0 SYStem.RESet
InterCom M7_0 SYStem.CPU ${T32_DEVICE_NAME}-CM7-0
InterCom M7_0 SYStem.CONFIG CORE 2. 1.
InterCom M7_0 SYStem.CONFIG SLAVE ON
SYStem.CONFIG DEBUGPORTTYPE SWD
SYStem.CONFIG SWDP  ON
IF COMBIPROBE()||UTRACE()
(
  SYStem.CONFIG.CONNECTOR MIPI20T
)
SYStem.Option DUALPORT ON
InterCom M7_0 SYStem.Option DUALPORT ON
(
  ; assert reset line and do another debugger based reset
  ; -> M0+ should stop in BootROM/Supervisory Flash
  SYStem.Option EnReset ON
  SYStem.Option WaitIDCODE ON
  SYStem.Option CoreSightRESet ON
)
SYStem.MemAccess DAP
SYStem.JtagClock 10MHz
Trace.DISable
InterCom M7_0 Trace.DISable
InterCom M7_0 ETM.OFF
InterCom M7_0 ITM.OFF
SYStem.Up

; --------------------------------------------------------------------------------
; Flash programming

; prepare flash programming (declarations)
DO ~~/demo/arm/flash/traveo_ii PREPAREONLY

; ReProgram Flash
FLASH.ReProgram ALL
Data.LOAD.Elf "&(ppd)/../${ARG_EXE_NAME_CM0PLUS}${CMAKE_EXECUTABLE_SUFFIX}" /NoRegister
Data.LOAD.Elf "&(ppd)/../${ARG_EXE_NAME_CM7_0}${CMAKE_EXECUTABLE_SUFFIX}" /NoRegister /NosYmbol
FLASH.ReProgram OFF

; --------------------------------------------------------------------------------
; Reset the target again
SYStem.Up

; --------------------------------------------------------------------------------
; Clock and power CM7 core(s) so that debugger can configure their resources (e.g. breakpoints)
&REG__SRSS_CLK_ROOT_SELECT1=AD:0x40261244
&REG__CPUSS_CM7_0_PWR_CTL=AD:0x40201200
&VALUE__SRSS_CLK_ROOT_SELECT=0x80000100        ; Enable clock and set DIRECT_MUX bit to select ROOT_MUX (not IMO)
&VALUE__CPUSS_CM7_x_PWR_CTL__ENABLE=0x05fa0003

Data.Set &REG__SRSS_CLK_ROOT_SELECT1 %Long &VALUE__SRSS_CLK_ROOT_SELECT
Data.Set &REG__CPUSS_CM7_0_PWR_CTL %Long &VALUE__CPUSS_CM7_x_PWR_CTL__ENABLE  ; Since CPUSS_CM7_x_CTL_CPU_WAIT bit is set after reset, CM7 does not yet execute any code

; --------------------------------------------------------------------------------
; Attach CM7_0, load symbols and prepare a breakpoint that should be hit once CM0+ enables CM7_0
InterCom M7_0 SYStem.Mode.Attach
InterCom M7_0 Data.LOAD.Elf "&(ppd)/../${ARG_EXE_NAME_CM7_0}${CMAKE_EXECUTABLE_SUFFIX}" /NoRegister /NoCODE
InterCom M7_0 TrOnchip.Set CORERESET OFF
InterCom M7_0 Break.direct &BREAKPOINT_LABEL_M7_0 /Onchip

; --------------------------------------------------------------------------------
; Initialize ONCHIP trace (M0+ MTB)
Trace.METHOD Onchip
Trace.TBADDRESS 0xf0010000
Trace.SIZE 4096.

; --------------------------------------------------------------------------------
; Start CM0+ program execution

; continue go till configured label (e.g. "main") if stopped at vector catch
REPEAT
(
  Go.direct &BREAKPOINT_LABEL_M0
  WAIT !STATE.RUN()
)
WHILE STATE.TARGET()=="stopped at vector catch"

; --------------------------------------------------------------------------------
; Initialize ONCHIP trace (M7_x: ETB)
InterCom M7_0 Trace.METHOD Onchip
InterCom M7_0 Trace.TraceCONNECT ETB
InterCom M7_0 ETM.Trace ON
InterCom M7_0 ETM.ON

; --------------------------------------------------------------------------------
; Open some default windows
WinCLEAR
Mode.Hll
WinPOS 0% 0% 50% 50%
List.auto
InterCom M7_0 WinCLEAR
InterCom M7_0 Mode.Hll
InterCom M7_0 WinPOS 0% 0% 50% 50%
InterCom M7_0 List.auto
InterCom M7_0 WinPOS 50% 0% 50% 50%
InterCom M7_0 Trace.List

ENDDO

