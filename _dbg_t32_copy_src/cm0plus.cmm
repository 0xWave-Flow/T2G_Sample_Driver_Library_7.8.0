;#################################################################################
; This file is generated by CMake during the configuration phase!
; Any user modification may be overwritten, therefore please consider to modify the 
; generation template file located in the folder <SDL>/cmake/template_files/t32
;#################################################################################

; --------------------------------------------------------------------------------
; Customization variables
&BREAKPOINT_LABEL_M0="main"

; --------------------------------------------------------------------------------
WinCLEAR

; --------------------------------------------------------------------------------
; Store current script path in &ppd
PRIVATE &ppd
&ppd=OS.PPD()

; --------------------------------------------------------------------------------
; Set titles for GUIs
TITLE "CM0+ (CYT4BFC) - TRACE32 for ARM"

; --------------------------------------------------------------------------------
; Set Trace32 MDI window position and size
FramePOS 0% 0% 50% 100% Auto

; --------------------------------------------------------------------------------
; SYStem settings
RESet
SYStem.RESet
SYStem.CPU CYT4BFC-CM0+
SYStem.CONFIG DEBUGPORTTYPE SWD
SYStem.CONFIG SWDP  ON
IF COMBIPROBE()||UTRACE()
(
  SYStem.CONFIG.CONNECTOR MIPI20T
)
SYStem.Option DUALPORT ON
(
  ; assert reset line and do another debugger based reset
  ; -> M0+ should stop in BootROM/Supervisory Flash
  SYStem.Option EnReset ON
  SYStem.Option WaitIDCODE ON
  SYStem.Option CoreSightRESet ON
)
SYStem.MemAccess DAP
SYStem.JtagClock 10MHz
Trace.DISable
SYStem.Up

; --------------------------------------------------------------------------------
; Flash programming

; prepare flash programming (declarations)
DO ~~/demo/arm/flash/traveo_ii PREPAREONLY

; ReProgram Flash
FLASH.ReProgram ALL
Data.LOAD.Elf "&(ppd)/../cm0plus.elf" /NoRegister
FLASH.ReProgram OFF

; --------------------------------------------------------------------------------
; Reset the target again
SYStem.Up

; --------------------------------------------------------------------------------
; Initialize ONCHIP trace (M0+ MTB)
Trace.METHOD Onchip
Trace.TBADDRESS 0xf0010000
Trace.SIZE 4096.

; --------------------------------------------------------------------------------
; Start CM0+ program execution

; continue go till configured label (e.g. "main") if stopped at vector catch
REPEAT
(
  Go.direct &BREAKPOINT_LABEL_M0
  WAIT !STATE.RUN()
)
WHILE STATE.TARGET()=="stopped at vector catch"

; --------------------------------------------------------------------------------
; Open some default windows
WinCLEAR
Mode.Hll
WinPOS 0% 0% 50% 50%
List.auto

ENDDO

